#include <stdio.h>
#include <math.h>
#include <avr/pgmspace.h>

const double WEIGHT[] PROGMEM = {0.120246392420696,9.34117854214066,2.74547800514145,-20.9366422096784,7.70932836038758,1.57750993760557,10.6110441965327,-0.146829650534326,-5.43750672473446,-1.94148705329952,-0.118150854888909,-3.59092495857086,0.862239996275232,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-5.73869411962012,0.734668454905925};

typedef double (*Activation)(double);

typedef struct _network {
   int layerCount; 
   double *weight;
   int *weightOffset;
   int *neuronCount; 
   int *bias;
   Activation *activation;
} Network;

double sigmoid(double x) {
  return 1 / (1 + exp(-x));
}

Network network;

void setup() {
  Serial.begin(57600);
  network.layerCount = 3;
  network.weight = WEIGHT;
  network.weightOffset = new int[network.layerCount]{1763, 123, 0};
  network.neuronCount = new int[network.layerCount]{40, 40, 3};
  network.bias = new int[network.layerCount]{1, 1, 0};
  network.activation = new Activation[network.layerCount]{sigmoid, sigmoid, sigmoid};
}

void loop() {
  int inputNeurons = network.neuronCount[0];
  int outputNeurons = network.neuronCount[network.layerCount - 1];
  double input[inputNeurons];// = {-117.45/2000,-595/2000,-1948.9/2000,4175.3/10000,484.9/2000,-655.3/2000,-2037.05/2000,621.25/10000,373.5/2000,-579.25/2000,-2065.95/2000,174.3/10000,21.95/2000,-529.4/2000,-2023.6/2000,729.2/10000,-63.6/2000,-716.6/2000,-1979.35/2000,76/10000,-191.5/2000,-708.9/2000,-1990.45/2000,590.55/10000,-91.45/2000,-859.9/2000,-1899.55/2000,-1227.95/10000,71.45/2000,-422.95/2000,-2084.75/2000,-2760.85/10000,121.7/2000,-418.3/2000,-2103.3/2000,247.75/10000,-9.7/2000,-496.1/2000,-1958/2000,-702.25/10000};
  double output[outputNeurons];
  readInput(input, network.neuronCount[0]);
  compute(network, input, output);
  for(int i = 0; i < 4 * outputNeurons; i++)
    Serial.write(*((byte*)output + i));
}

void readInput(double input[], int inputCount) {
  for(int i = 0; i < inputCount; i++) {
    byte bytes[4];
    while(Serial.available() < 4);
    bytes[0] = Serial.read();
    bytes[1] = Serial.read();
    bytes[2] = Serial.read();
    bytes[3] = Serial.read();
    input[i] = *((float*)bytes);
  }
}

void compute(Network network, double input[], double output[]) {
  //Initialize arrays to hold input and output values during layer computation.
  int maxNeurons = 0;
  for(int layer = 0; layer < network.layerCount; layer++) {
    maxNeurons = max(maxNeurons, network.neuronCount[layer] + 1);
  }
  double tempIn[maxNeurons], tempOut[maxNeurons];

  //Initialize input
  for(int i = 0; i < network.neuronCount[0]; i++) {
    tempIn[i] = input[i];
  }
  tempIn[network.neuronCount[0]] = network.bias[0];

  //Calculate output for each layer
  for (int layer = 1; layer < network.layerCount; layer++) {
    int offsetIndex = network.weightOffset[layer];
    int fromCount = network.neuronCount[layer - 1] + network.bias[layer - 1];
    int toCount = network.neuronCount[layer];
    Activation activation = network.activation[layer];

    //For each neuron in the next layer
    for (int toNeuron = 0; toNeuron < toCount; toNeuron++) {
      //Calculate weighted sum from the current layer
      double weightedSum = 0;
      for (int fromNeuron = 0; fromNeuron < fromCount; fromNeuron++) {
          weightedSum += pgm_read_float_near(network.weight + toNeuron * fromCount + fromNeuron + offsetIndex) * tempIn[fromNeuron];
      }

      //Apply activation function
      tempOut[toNeuron] = activation(weightedSum);
    }

    //Prepare input for next layer
    for (int toNeuron = 0; toNeuron < toCount; toNeuron++) {
        tempIn[toNeuron] = tempOut[toNeuron];
    }
    tempIn[toCount] = network.bias[layer];
  }

  //Output from last layer
  for(int i = 0; i < network.neuronCount[network.layerCount - 1]; i++) {
    output[i] = tempOut[i];
  }
}
